## build/poky-master-oe/conf/bblayers.conf
```bitbake
BBLAYERS ?= " \
  ${TOPDIR}/../../layers/openembedded-core/meta \
  ${TOPDIR}/../../layers/openembedded-core/meta-selftest \
  ${TOPDIR}/../../layers/meta-yocto/meta-yocto-bsp \
  ${TOPDIR}/../../layers/meta-yocto/meta-poky \
  ${TOPDIR}/../../layers/meta-openembedded/meta-oe \
  ${TOPDIR}/../../layers/meta-openembedded/meta-python \
  "
```

## build/poky-master/conf/bblayers.conf
```bitbake
BBLAYERS ?= " \
  ${TOPDIR}/../../layers/openembedded-core/meta \
  ${TOPDIR}/../../layers/openembedded-core/meta-selftest \
  ${TOPDIR}/../../layers/meta-yocto/meta-yocto-bsp \
  ${TOPDIR}/../../layers/meta-yocto/meta-poky \
  "
```
